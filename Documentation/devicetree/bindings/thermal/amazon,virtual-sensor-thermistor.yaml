## Documentation/devicetree/bindings/thermal/amazon,virtual-sensor-thermistor.yaml
```yaml
# SPDX-License-Identifier: (GPL-2.0 OR BSD-2-Clause)
%YAML 1.2
---
$id: http://devicetree.org/schemas/thermal/amazon,virtual-sensor-thermistor.yaml#
$schema: http://devicetree.org/meta-schemas/core.yaml#

title: Amazon MT8163 virtual sensor thermistor

maintainers:
  - Andy Slater <aslater3@googlemail.com>

description: |
  IIO-backed Murata NCP15XH103F03RC thermistors used by Amazon MT8163
  Radar-Puffin/Giza boards. The offset, alpha and weight properties retain
  the parameters consumed by the vendor virtual thermal policy.

properties:
  compatible:
    const: amazon,virtual_sensor_thermistor

  io-channels:
    maxItems: 1
    description: MT8163 AUXADC input carrying the thermistor divider voltage.

  aux_channel_num:
    minimum: 0
    maximum: 2
    description: Legacy logical sensor index, distinct from the AUXADC input.

  thermistor,offset:
    $ref: /schemas/types.yaml#/definitions/uint32

  thermistor,offset.sign:
    enum:
      - plus
      - minus

  thermistor,alpha:
    $ref: /schemas/types.yaml#/definitions/uint32

  thermistor,weight:
    $ref: /schemas/types.yaml#/definitions/uint32

  virtual-sensor-id:
    $ref: /schemas/types.yaml#/definitions/uint32

required:
  - compatible
  - io-channels
  - aux_channel_num
  - thermistor,offset
  - thermistor,offset.sign
  - thermistor,alpha
  - thermistor,weight

additionalProperties: false

examples:
  - |
    thermistor {
        compatible = "amazon,virtual_sensor_thermistor";
        io-channels = <&auxadc 0>;
        aux_channel_num = <0>;
        thermistor,offset = <15000>;
        thermistor,offset.sign = "plus";
        thermistor,alpha = <15>;
        thermistor,weight = <400>;
    };
...
```

## drivers/iio/light/libreecho/Kconfig
```kconfig
# SPDX-License-Identifier: GPL-2.0-only

menu "LibreEcho Radar-Puffin ambient light sensors"

config ALS_TSL2583
	tristate "Vendor TAOS TSL2584TSV ambient light sensor"
	depends on I2C
	depends on IIO
	help
	  Port of the Radar-Puffin vendor TSL2580/TSL2581/TSL2583/
	  TSL2584TSV driver. It preserves the vendor IIO sysfs ABI and
	  supports the ams,tsl2584tsv DT compatible.

config ALS_TSL2584_AUTOZERO
	bool "Enable periodic autozero of AMS TSL2584TSV"
	depends on ALS_TSL2583
	help
	  Run the vendor autozero sequence at the interval supplied by the
	  autozero-period-ms DT property.

config SENSORS_TSL2540
	tristate "Vendor AMS TSL2540 ambient light sensor"
	depends on I2C
	help
	  Port of the Radar-Puffin vendor TSL2540 driver. It preserves the
	  vendor device sysfs ABI and supports the amstaos,tsl2540 DT
	  compatible and calibration properties.

config AMZN_AMS_ALS
	bool "Vendor calibrated-lux sysfs ABI"
	depends on ALS_TSL2583 || SENSORS_TSL2540
	help
	  Expose the vendor calibrated_lux and als_calibrated_lux sysfs
	  attributes backed by the factory /idme/alscal data.

config AMS_ADJUST_WITH_BASELINE
	bool "Use factory baseline in AMS lux calculations"
	depends on ALS_TSL2583 || SENSORS_TSL2540
	help
	  Adjust the vendor lux calculations with the factory calibration
	  baseline from /idme/alscal.

endmenu
```

## drivers/misc/mediatek/Kconfig
```kconfig
# SPDX-License-Identifier: GPL-2.0-only

config MTK_MT8163_CONSYS
	bool "MediaTek MT8163 integrated CONSYS connectivity"
	depends on ARM && ARCH_MEDIATEK && OF && HAS_IOMEM
	depends on NET && RFKILL
	select CFG80211
	select CRC32
	select FW_LOADER
	select ZLIB_DEFLATE
	select WIRELESS
	select WIRELESS_EXT
	select WEXT_CORE
	select WEXT_PROC
	select WEXT_PRIV
	help
	  Build the legacy integrated MT8163 CONSYS/WMT, BTIF, Wi-Fi and
	  Bluetooth stack.  This driver binds the byte-identical vendor
	  "mediatek,mt8163-consys" device-tree node and retains the character
	  device ABI used by the MT8163 v181 WMT and Bluetooth helpers.

	  This is an isolated forward port of the vendor Linux 3.18 driver.
	  It is intended only for MT8163 systems carrying that legacy ABI.

config MTK_COMBO
	bool
	default y if MTK_MT8163_CONSYS

config MTK_COMBO_CHIP_CONSYS_8163
	bool
	default y if MTK_MT8163_CONSYS

config MTK_COMBO_CHIP
	string
	default "CONSYS_8163" if MTK_MT8163_CONSYS

config MTK_PLATFORM
	string
	default "mt8163" if MTK_MT8163_CONSYS

config ARCH_MTK_PROJECT
	string
	default "radar" if MTK_MT8163_CONSYS

config MTK_BTIF
	bool
	default y if MTK_MT8163_CONSYS

config MTK_COMBO_BT
	bool
	default y if MTK_MT8163_CONSYS

config MTK_MT8163_BLUEZ_HCI
	bool "MT8163 Bluetooth HCI bridge for BlueZ"
	depends on BT && MTK_MT8163_CONSYS
	default y if MTK_MT8163_CONSYS && BT
	help
	  Register the STP BT character device as a BlueZ HCI controller so
	  Linux exposes /sys/class/bluetooth/hci0.  The legacy /dev/stpbt
	  diagnostic interface is retained.  Without this symbol the BTIF
	  transport initializes but no HCI controller is visible to userspace.

config MTK_COMBO_WIFI
	bool
	default y if MTK_MT8163_CONSYS

config MTK_WIFI_ANTENNA_SWITCH
	bool "MT8163 manual Wi-Fi antenna switching"
	depends on MTK_MT8163_CONSYS
	default n
	help
	  Enable the Radar-Puffin stock WMT antenna/coexistence bootstrap,
	  including the 0x81060010 antenna-selection register write.

config MTK_WIFI_ANTENNA_SELECT
	bool "MT8163 Wi-Fi antenna selection"
	depends on MTK_WIFI_ANTENNA_SWITCH
	default n
	help
	  Enable the vendor WLAN antenna-selection controls used by the
	  stock Radar-Puffin configuration.

config MTK_WAPI_SUPPORT
	bool
	default n

config MTK_WIFI_MCC_SUPPORT
	bool
	default n

config MTK_WIFI_PM_CONTROL
	bool
	default n
```
